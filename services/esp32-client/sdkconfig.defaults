## services/esp32-client/sdkconfig.defaults
```kconfig
# Flash / chip settings
CONFIG_ESPTOOLPY_FLASHSIZE_16MB=y
CONFIG_ESPTOOLPY_FLASHSIZE="16MB"
CONFIG_ESPTOOLPY_FLASHFREQ_80M=y
CONFIG_ESPTOOLPY_FLASHMODE_QIO=y

# Partition table: single large app
CONFIG_PARTITION_TABLE_SINGLE_APP_LARGE=y

# PSRAM (ESP32-S3-N16R8 has 8MB OPI PSRAM)
CONFIG_SPIRAM=y
CONFIG_SPIRAM_MODE_OCT=y
CONFIG_SPIRAM_SPEED_80M=y
CONFIG_SPIRAM_USE_CAPS_ALLOC=y

# Task stack
CONFIG_ESP_MAIN_TASK_STACK_SIZE=8192

# FreeRTOS 1kHz tick
CONFIG_FREERTOS_HZ=1000

# WebSocket client
CONFIG_ESP_WEBSOCKET_CLIENT_ENABLE=y

# Larger log buffer for serial output
CONFIG_LOG_DEFAULT_LEVEL_INFO=y
```
