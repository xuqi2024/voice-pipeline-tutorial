#include "ssd1306.h"
#include "driver/i2c.h"
#include "esp_log.h"
#include <string.h>
#include <stdio.h>
#include <stdarg.h>

#define TAG "SSD1306"
#define SSD1306_TIMEOUT_MS 50

static i2c_port_t  s_port;
static uint8_t     s_addr;
static uint8_t     s_fb[SSD1306_W * SSD1306_H / 8]; // frame buffer, 1024 bytes

/* 5x7 ASCII font (chars 0x20..0x7E), each char = 5 column bytes */
static const uint8_t font5x7[][5] = {
    {0x00,0x00,0x00,0x00,0x00}, // ' '
    {0x00,0x00,0x5F,0x00,0x00}, // '!'
    {0x00,0x07,0x00,0x07,0x00}, // '"'
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    {0x0C,0x02,0x0C,0x10,0x0C}, // '~'
};

/* ─── low-level I2C helpers ─────────────────────────────────────── */
static esp_err_t _cmd(uint8_t c) {
    uint8_t buf[2] = {0x00, c};
    return i2c_master_write_to_device(s_port, s_addr, buf, 2,
                                      pdMS_TO_TICKS(SSD1306_TIMEOUT_MS));
}

static void _data_buf(const uint8_t *data, size_t len) {
    /* send 0x40 control byte then data in one transaction */
    uint8_t *tmp = malloc(len + 1);
    if (!tmp) return;
    tmp[0] = 0x40;
    memcpy(tmp + 1, data, len);
    i2c_master_write_to_device(s_port, s_addr, tmp, len + 1,
                               pdMS_TO_TICKS(SSD1306_TIMEOUT_MS));
    free(tmp);
}

/* ─── public API ─────────────────────────────────────────────────── */
esp_err_t ssd1306_init(i2c_port_t port, int sda_io, int scl_io, uint8_t addr) {
    s_port = port;
    s_addr = addr;

    i2c_config_t cfg = {
        .mode             = I2C_MODE_MASTER,
        .sda_io_num       = sda_io,
        .scl_io_num       = scl_io,
        .sda_pullup_en    = GPIO_PULLUP_ENABLE,
        .scl_pullup_en    = GPIO_PULLUP_ENABLE,
        .master.clk_speed = 400000,
    };
    ESP_ERROR_CHECK(i2c_param_config(port, &cfg));
    ESP_ERROR_CHECK(i2c_driver_install(port, I2C_MODE_MASTER, 0, 0, 0));

    static const uint8_t init_seq[] = {
        0xAE,       // display off
        0xD5, 0x80, // clock divide
        0xA8, 63,   // multiplex ratio
        0xD3, 0x00, // display offset
        0x40,       // start line 0
        0x8D, 0x14, // charge pump on
        0x20, 0x00, // horizontal addressing
        0xA1,       // seg remap
        0xC8,       // com output scan dir
        0xDA, 0x12, // com pins config
        0x81, 0xCF, // contrast
        0xD9, 0xF1, // pre-charge
        0xDB, 0x40, // vcomh deselect
        0xA4,       // display RAM
        0xA6,       // normal (not inverted)
        0xAF,       // display on
    };
    for (size_t i = 0; i < sizeof(init_seq); i++) {
        esp_err_t e = _cmd(init_seq[i]);
        if (e != ESP_OK) { ESP_LOGE(TAG, "SSD1306 init fail at byte %d", (int)i); return e; }
    }
    ssd1306_clear();
    ssd1306_flush();
    return ESP_OK;
}

void ssd1306_clear(void) {
    memset(s_fb, 0, sizeof(s_fb));
}

void ssd1306_flush(void) {
    _cmd(0x21); _cmd(0); _cmd(127); // col 0..127
    _cmd(0x22); _cmd(0); _cmd(7);   // page 0..7
    _data_buf(s_fb, sizeof(s_fb));
}

void ssd1306_puts(int col, int row, const char *text) {
    /* row = 0..7 (8-pixel page), col = 0..21 (6 pixels/char + 1 space) */
    while (*text && col < 22) {
        uint8_t c = (uint8_t)*text++;
        if (c < 0x20 || c > 0x7E) { col++; continue; }
        const uint8_t *glyph = font5x7[c - 0x20];
        for (int x = 0; x < 5; x++) {
            int px = col * 6 + x;
            if (px >= SSD1306_W) break;
            s_fb[row * SSD1306_W + px] = glyph[x];
        }
        /* 1-pixel gap */
        int gap = col * 6 + 5;
        if (gap < SSD1306_W) s_fb[row * SSD1306_W + gap] = 0;
        col++;
    }
}

void ssd1306_printf(int col, int row, const char *fmt, ...) {
    char buf[64];
    va_list ap;
    va_start(ap, fmt);
    vsnprintf(buf, sizeof(buf), fmt, ap);
    va_end(ap);
    ssd1306_puts(col, row, buf);
}
